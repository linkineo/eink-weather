## components/epd_uc8179/Kconfig
```kconfig
menu "E-paper UC8179 driver"

    choice EPD_PANEL
        prompt "E-paper panel"
        default EPD_PANEL_7IN5B_V2
        help
            Selects the command sequences used by the driver. Both panels are
            800x480 and driven by a UC8179 controller, but they differ in the
            panel setting (PSR 0x00) and VCOM/data interval (CDI 0x50) values
            and in how the second data plane (DTM2, 0x13) is interpreted.

        config EPD_PANEL_7IN5B_V2
            bool "7.5inch (B) V2 800x480 black/white/red"
            help
                Waveshare 7.5inch e-Paper (B) V2, three colours.
                Panel label DKE DEPG0750RWU790F30HP.
                PSR = 0x0F (BWR OTP LUT), CDI = 0x11 0x07.
                DTM1 (0x10) carries the black plane, DTM2 (0x13) the red plane.

        config EPD_PANEL_7IN5_V2
            bool "7.5inch V2 800x480 black/white"
            help
                Waveshare 7.5inch e-Paper V2, two colours.
                PSR = 0x1F (BW OTP LUT), CDI = 0x10 0x07.
                DTM1 (0x10) carries the image, DTM2 (0x13) its complement.
                The red argument of epd_display() is ignored.

    endchoice

    config EPD_BUSY_TIMEOUT_MS
        int "BUSY wait timeout (ms)"
        default 60000
        range 1000 300000
        help
            Upper bound for every wait on the BUSY_N line. A full refresh of
            the tri-colour panel takes roughly 15-25 s, so the default leaves
            a wide margin. On expiry the driver gives up and returns
            ESP_ERR_TIMEOUT instead of blocking forever.

    config EPD_SPI_HZ
        int "SPI clock (Hz)"
        default 4000000
        range 100000 10000000
        help
            Clock for the write path to the panel. The UC8179 allows a 100 ns
            write cycle (10 MHz); register reads no longer share this device
            (they are bit-banged, see EPD_DATA_BITBANG below), so the old
            5 MHz read limit does not apply here. 4 MHz is the value the
            bring-up runs used. epd_bus_init() overrides this with
            epd_pins_t.spi_hz when that field is positive.

    config EPD_DATA_BITBANG
        bool "Send commands and image data by bit-banging GPIO instead of the SPI peripheral (slow diagnostic mode)"
        default n
        help
            Diagnostic fallback. With this enabled epd_bus_init() does not
            initialise the SPI peripheral at all: every command and every
            image byte is clocked out by hand, exactly like Waveshare's own
            ESP32 demo (DEV_Config.cpp DEV_SPI_WriteByte). Roughly 1-3 s per
            48000-byte plane instead of ~0.1 s, so it is not meant for normal
            operation -- but it removes the SPI peripheral and its DMA from
            the picture, which is what you want when the panel comes up as
            noise and you need to know whether the data path is at fault.

            The controller probe always bit-bangs regardless of this option;
            the SPI peripheral cannot read the 3-wire bus.

endmenu
```

## main/Kconfig.projbuild
```kconfig
menu "Weather display"

    config WEATHER_POLL_MINUTES
        int "Ecowitt poll / display refresh interval (minutes)"
        range 1 1440
        default 15
        help
            Refresh slots are aligned to multiples of this many minutes past
            local midnight (15 -> :00, :15, :30, :45). Pick a divisor of 1440.

    config WEATHER_FETCH_LEAD_SECONDS
        int "Start the data fetch this many seconds before each slot"
        range 0 600
        default 30

    config WEATHER_WAKE_LEAD_SECONDS
        int "Wake from deep sleep this many seconds before each slot"
        range 10 600
        default 60
        help
            Covers boot, Wi-Fi association, SNTP and RTC clock drift. Must be
            larger than WEATHER_FETCH_LEAD_SECONDS.

    config WEATHER_TZ
        string "POSIX timezone for date and last-update time"
        default "CET-1CEST,M3.5.0,M10.5.0/3"
        help
            Default is Central European Time (the station reports Europe/Zurich).

    config ECOWITT_MAC
        string "Ecowitt station MAC (leave empty to auto-detect)"
        default ""
        help
            If empty, the first device returned by /device/list for the API
            keys is used and cached in NVS.

endmenu
```
